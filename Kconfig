## drivers/pump/smartpump/Kconfig
```kconfig
# Copyright (c) 2021 Nordic Semiconductor ASA
# SPDX-License-Identifier: Apache-2.0

config SMARTPUMP
	bool "Lee Smart Pump"
	default y
	depends on (DT_HAS_ZEPHYR_SMARTPUMP_ENABLED)
	select I2C
	help
	  Enable smartpump

config SMARTPUMP_LOG_LEVEL
    int "Log level for the Smartpump driver"
    range 0 4
    default 0
    help
        Sets log level for My Module.
              Levels are:
              0 OFF, do not write
              1 ERROR, only write LOG_ERR
              2 WARNING, write LOG_WRN in addition to previous level
              3 INFO, write LOG_INF in addition to previous levels
              4 DEBUG, write LOG_DBG in addition to previous levels
```

## dts/bindings/zephyr,solenoid.yaml
```yaml
# Copyright (c) 2021 Nordic Semiconductor ASA
# SPDX-License-Identifier: Apache-2.0

description: |
  Solenoid with a GPIO to control on or off.

compatible: "zephyr,solenoid"

properties:
  gpios:
    type: phandle-array
    required: true
    description: |
      The GPIO connected to the valve driver.
```
